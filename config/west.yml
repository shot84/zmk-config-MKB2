## config/west.yml
```yaml
manifest:
  remotes:
    - name: zmkfirmware
      url-base: https://github.com/zmkfirmware
    - name: caksoylar
      url-base: https://github.com/caksoylar
    - name: badjeff
      url-base: https://github.com/badjeff
    - name: te9no
      url-base: https://github.com/te9no
    - name: kot149
      url-base: https://github.com/kot149
    - name: mctechnology17
      url-base: https://github.com/mctechnology17
    - name: petejohanson
      url-base: https://github.com/petejohanson
    - name: cormoran
      url-base: https://github.com/cormoran
    - name: prospector  # <-- Prospector Scanner
      url-base: https://github.com/t-ogura  # ★これを追加
    - name: sekigon-gonnoc
      url-base: https://github.com/sekigon-gonnoc
    - name: taichan1113
      url-base: https://github.com/taichan1113
    - name: nlazcani
      url-base: https://github.com/nlazcani

  projects:
    - name: zmk
      # remote: zmkfirmware
      remote: te9no
      revision: v0.3-branch+dya
      import: app/west.yml
    - name: zmk-rgbled-widget
      remote: caksoylar
      revision: v0.3-branch
    - name: zmk-pmw3610-driver
      remote: badjeff
      revision: zmk-0.3
    - name: zmk-analog-input-driver
      remote: badjeff
      revision: main
    - name: zmk-nice-oled
      remote: te9no
      revision: main
    - name: zmk-layout-shift
      remote: kot149
      revision: v1
    - name: zmk-input-processor-keybind
      remote: te9no
      revision: main
    - name: cirque-input-module
      remote: petejohanson
      revision: main
    - name: zmk-driver-MLX90393
      remote: te9no
      revision: main

    - name: zmk-module-runtime-input-processor
      remote: cormoran
      revision: zmk-v0.3.0.0
    - name: zmk-module-battery-history
      remote: cormoran
      revision: main
    - name: zmk-module-ble-management
      remote: cormoran
      revision: zmk-v0.3.0.0
    - name: zmk-module-settings-rpc
      remote: cormoran
      revision: main

    - name: prospector-zmk-module
      remote: prospector
      revision: v1.0.0
      path: modules/prospector-zmk-module

    - name: zmk-driver-paw3222
      remote: sekigon-gonnoc
      revision: v0.2
    - name: zmk-driver-pat9125
      remote: taichan1113
      revision: main   # 現HEAD f5c1937 (2026-04) で固定可

    - name: zmk-input-processor-rotate
      remote: nlazcani
      revision: main

  self:
    path: config
```
